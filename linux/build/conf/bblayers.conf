## linux/build/conf/bblayers.conf
```bitbake
# POKY_BBLAYERS_CONF_VERSION is increased each time build/conf/bblayers.conf
# changes incompatibly
POKY_BBLAYERS_CONF_VERSION = "2"

BBPATH = "${TOPDIR}"
BBFILES ?= ""

BBLAYERS ?= " \
  /project/linux/poky/meta \
  /project/linux/poky/meta-poky \
  /project/linux/poky/meta-yocto-bsp \
  /project/linux/meta-openembedded/meta-oe \
  /project/linux/meta-openembedded/meta-python \
  /project/linux/meta-openembedded/meta-networking \
  /project/linux/meta-nokia \
  "
```

## linux/meta-nokia/conf/distro/nokia.conf
```bitbake
include poky.conf

DISTRO = "nokia"
DISTRO_NAME = "35C3 phone pwnage"
DISTRO_VERSION = "1.0.0"
DISTRO_CODENAME = "nokia"
LOCALCONF_VERSION = "1"

DISTRO_FEATURES_append = " ipv4 alsa systemd"
DISTRO_FEATURES_remove = " sysvinit pulseaudio 3g bluetooth irda pcmcia nfs nfc x11 wayland zeroconf"

VIRTUAL-RUNTIME_init_manager = "systemd"

VIRTUAL-RUNTIME_initscripts = ""
DISTRO_FEATURES_BACKFILL_CONSIDERED = "sysvinit"
```

## linux/meta-nokia/conf/layer.conf
```bitbake
# We might have a conf and classes directory, append to BBPATH
BBPATH .= ":${LAYERDIR}"

# We have a recipes directory, add to BBFILES
BBFILES += "${LAYERDIR}/recipes*/*/*.bb ${LAYERDIR}/recipes*/*/*.bbappend"

BBFILE_COLLECTIONS += "meta-nokia"
BBFILE_PATTERN_meta-nokia := "^${LAYERDIR}/"
BBFILE_PRIORITY_meta-nokia = "10"

LAYERSERIES_COMPAT_meta-nokia = "thud"
```

## linux/meta-nokia/conf/machine/nokia.conf
```bitbake
#@TYPE: Machine
#@NAME: Nokia on Versatile express with Cortex-A15
#@DESCRIPTION: Nokia on Versatile express with Cortex-A15

DEFAULTTUNE ?= "cortexa15thf-neon-vfpv4"

PREFERRED_PROVIDER_virtual/kernel ?= "linux-nokia"
PREFERRED_VERSION_linux-nokia ?= "4.18%"

MACHINE_EXTRA_RRECOMMENDS = "kernel-modules kernel-devicetree"

OPTEEMACHINE = "vexpress-qemu_virt"
OPTEEOUTPUTMACHINE = "vexpress"
BIOS_COMMAND_LINE = "root=/dev/vda rw console=ttyAMA0"

require conf/machine/include/qemu.inc
require conf/machine/include/tune-cortexa15.inc

SERIAL_CONSOLE = "115200 ttyAMA0"
IMAGE_FSTYPES = "ext4"

MACHINE_EXTRA_RDEPENDS += "qemu-bios optee-os"
```
